`default_nettype none

module top (
    input  wire clk_27m,
    input  wire ddc_dvalid,
    output wire [5:0] led,
    output wire dvalid_seen_pin,
    input  wire ddc_dout,
    output wire ddc_dxmit,
    output wire ddc_dclk,

    output reg  ddc_clk_2m,
    output reg  ddc_conv,
    output wire uart_tx
);

    wire clk_48m;
    wire pll_lock;

    // Generated by Gowin IP Core Generator
    // Input  : 27 MHz
    // Output : 48 MHz
    Gowin_rPLL u_pll (
        .clkout(clk_48m),
        .lock(pll_lock),
        .clkin(clk_27m)
    );

    // 48 MHz / 2 MHz = 24
    // 2 MHz half period = 12 clocks of 48 MHz
    reg [3:0] div_2m_cnt;

    // CONV toggles every 5000 cycles of 2 MHz
    // 2 MHz period = 0.5 us
    // 5000 cycles = 2.5 ms
    // CONV full period = 5 ms = 200 Hz
    reg [12:0] conv_half_cnt;

    always @(posedge clk_48m) begin
        if (!pll_lock) begin
            div_2m_cnt   <= 4'd0;
            conv_half_cnt <= 13'd0;

            ddc_clk_2m <= 1'b0;
            ddc_conv   <= 1'b0;
        end else begin
            // Generate 2 MHz clock
            if (div_2m_cnt == 4'd11) begin
                div_2m_cnt <= 4'd0;
                ddc_clk_2m <= ~ddc_clk_2m;

                // This block runs at every edge of ddc_clk_2m.
                // We want to count only rising edges.
                if (ddc_clk_2m == 1'b0) begin
                    // ddc_clk_2m will become 1 here,
                    // so this corresponds to a rising edge.

                    if (conv_half_cnt == 13'd4999) begin
                        conv_half_cnt <= 13'd0;
                        ddc_conv <= ~ddc_conv;
                    end else begin
                        conv_half_cnt <= conv_half_cnt + 13'd1;
                    end
                end

            end else begin
                div_2m_cnt <= div_2m_cnt + 4'd1;
            end
        end
    end

    wire rst_n = 1'b1;
    wire [39:0] ddc_data;
    wire        ddc_data_ready;
    wire        ddc_busy;
    wire        dvalid_seen;

    ddc_readout u_ddc_readout (
        .clk_48m      (clk_48m),
        .rst_n        (rst_n),

        .dvalid_in    (ddc_dvalid),
        .dout_in      (ddc_dout),

        .dxmit        (ddc_dxmit),
        .dclk         (ddc_dclk),

        .data_shift   (ddc_data),
        .data_ready   (ddc_data_ready),
        .busy         (ddc_busy),
        .dvalid_seen  (dvalid_seen)
    );


    reg data_ready_seen;

    always @(posedge clk_48m or negedge rst_n) begin
        if (!rst_n) begin
            data_ready_seen <= 1'b0;
        end else begin
            if (ddc_data_ready) begin
                data_ready_seen <= 1'b1;
            end
        end
    end


    assign led[0] = ~dvalid_seen;
    assign led[1] = ~ddc_busy;
    assign led[2] = ~data_ready_seen;
    assign led[3] = ~ddc_data[39];
    assign led[4] = ~ddc_data[20];
    assign led[5] = ~ddc_data[19];

    ddc_uart_reporter u_ddc_uart_reporter (
        .clk_48m        (clk_48m),
        .rst_n          (rst_n),

        .ddc_data       (ddc_data),
        .ddc_data_ready (ddc_data_ready),

        .uart_tx        (uart_tx)
    );

endmodule

`default_nettype wire
